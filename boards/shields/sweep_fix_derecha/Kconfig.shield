## boards/shields/sweep_fix_derecha/Kconfig.shield
```kconfig
config SHIELD_SWEEP_FIX_DERECHA
    def_bool $(shields_list_contains,sweep_fix_derecha)
```

## boards/shields/sweep_fix_izquierda/Kconfig.shield
```kconfig
config SHIELD_SWEEP_FIX_IZQUIERDA
    def_bool $(shields_list_contains,sweep_fix_izquierda)
```

## boards/shields/sweep_scan_todo/Kconfig.shield
```kconfig
config SHIELD_SWEEP_SCAN_TODO
    def_bool $(shields_list_contains,sweep_scan_todo)
```
